/* Copyright (c) 2012-2015, The Linux Foundation. All rights reserved.
 * Copyright (C) 2018 XiaoMi, Inc.
 *
 * This program is free software; you can redistribute it and/or modify
 * it under the terms of the GNU General Public License version 2 and
 * only version 2 as published by the Free Software Foundation.
 *
 * This program is distributed in the hope that it will be useful,
 * but WITHOUT ANY WARRANTY; without even the implied warranty of
 * MERCHANTABILITY or FITNESS FOR A PARTICULAR PURPOSE.  See the
 * GNU General Public License for more details.
 */

&mdss_mdp {
	dsi_nt36672_csot_fhdplus_e7_vid: qcom,mdss_dsi_nt36672_csot_fhdplus_video_e7 {
		qcom,mdss-dsi-panel-name = "nt36672 csot e7 fhdplus video mode dsi panel";
		qcom,mdss-dsi-panel-type = "dsi_video_mode";
		qcom,mdss-dsi-panel-framerate = <60>;
		qcom,mdss-dsi-virtual-channel-id = <0>;
		qcom,mdss-dsi-stream = <0>;
		qcom,mdss-dsi-panel-width = <1080>;
		qcom,mdss-dsi-panel-height = <2160>;
		qcom,mdss-dsi-h-front-porch = <108>;
		qcom,mdss-dsi-h-back-porch = <62>;
		qcom,mdss-dsi-h-pulse-width = <20>;
		qcom,mdss-dsi-h-sync-skew = <0>;
		qcom,mdss-dsi-v-back-porch = <8>;
		qcom,mdss-dsi-v-front-porch = <10>;
		qcom,mdss-dsi-v-pulse-width = <2>;
		qcom,mdss-dsi-h-left-border = <0>;
		qcom,mdss-dsi-h-right-border = <0>;
		qcom,mdss-dsi-v-top-border = <0>;
		qcom,mdss-dsi-v-bottom-border = <0>;
		qcom,mdss-dsi-bpp = <24>;
		qcom,mdss-dsi-underflow-color = <0xff>;
		qcom,mdss-dsi-border-color = <0>;
		qcom,mdss-dsi-on-command =
		[
			39 01 00 00 00 00 02 FF 25
			39 01 00 00 00 00 02 FB 01
			39 01 00 00 00 00 02 8D 04
			39 01 00 00 00 00 02 FF 20
			39 01 00 00 00 00 02 FB 01
			39 01 00 00 00 00 02 30 10
			39 01 00 00 00 00 02 31 50
			39 01 00 00 00 00 02 32 2F
			39 01 00 00 00 00 02 94 00
			39 01 00 00 00 00 02 95 E1
			39 01 00 00 00 00 02 96 E1
			39 01 00 00 00 00 02 FF 20             //Enter CMD2_P0
			39 01 00 00 00 00 02 FB 01
			39 01 00 00 00 00 02 AF 00             //R G B Gamma independent
			39 01 00 00 00 00 11 B0 00 00 00 11 00 30 00 4A 00 62 00 77 00 8B 00 9D
			39 01 00 00 00 00 11 B1 00 AD 00 E4 01 10 01 52 01 85 01 D2 02 10 02 12
			39 01 00 00 00 00 11 B2 02 4D 02 91 02 BD 02 F4 03 18 03 46 03 54 03 62
			39 01 00 00 00 00 0D B3 03 73 03 84 03 99 03 C1 03 D5 03 D9
			39 01 00 00 00 00 11 B4 00 00 00 11 00 30 00 4A 00 62 00 77 00 8B 00 9D
			39 01 00 00 00 00 11 B5 00 AD 00 E4 01 10 01 52 01 85 01 D2 02 10 02 12
			39 01 00 00 00 00 11 B6 02 4D 02 91 02 BD 02 F4 03 18 03 46 03 54 03 62
			39 01 00 00 00 00 0D B7 03 73 03 84 03 99 03 C1 03 D5 03 D9
			39 01 00 00 00 00 11 B8 00 00 00 11 00 30 00 4A 00 62 00 77 00 8B 00 9D
			39 01 00 00 00 00 11 B9 00 AD 00 E4 01 10 01 52 01 85 01 D2 02 10 02 12
			39 01 00 00 00 00 11 BA 02 4D 02 91 02 BD 02 F4 03 18 03 46 03 54 03 62
			39 01 00 00 00 00 0D BB 03 73 03 84 03 99 03 C1 03 D5 03 D9
			39 01 00 00 00 00 02 FF 21             //Enter CMD2_P1
			39 01 00 00 00 00 02 FB 01
			39 01 00 00 00 00 11 B0 00 00 00 11 00 30 00 4A 00 62 00 77 00 8B 00 9D
			39 01 00 00 00 00 11 B1 00 AD 00 E4 01 10 01 52 01 85 01 D2 02 10 02 12
			39 01 00 00 00 00 11 B2 02 4D 02 91 02 BD 02 F4 03 18 03 46 03 54 03 62
			39 01 00 00 00 00 0D B3 03 73 03 84 03 99 03 C1 03 D5 03 D9
			39 01 00 00 00 00 11 B4 00 00 00 11 00 30 00 4A 00 62 00 77 00 8B 00 9D
			39 01 00 00 00 00 11 B5 00 AD 00 E4 01 10 01 52 01 85 01 D2 02 10 02 12
			39 01 00 00 00 00 11 B6 02 4D 02 91 02 BD 02 F4 03 18 03 46 03 54 03 62
			39 01 00 00 00 00 0D B7 03 73 03 84 03 99 03 C1 03 D5 03 D9
			39 01 00 00 00 00 11 B8 00 00 00 11 00 30 00 4A 00 62 00 77 00 8B 00 9D
			39 01 00 00 00 00 11 B9 00 AD 00 E4 01 10 01 52 01 85 01 D2 02 10 02 12
			39 01 00 00 00 00 11 BA 02 4D 02 91 02 BD 02 F4 03 18 03 46 03 54 03 62
			39 01 00 00 00 00 0D BB 03 73 03 84 03 99 03 C1 03 D5 03 D9
			39 01 00 00 00 00 02 FF 10
			39 01 00 00 00 00 02 FB 01
			39 01 00 00 00 00 02 51 FF
			39 01 00 00 00 00 02 53 24
			39 01 00 00 00 00 02 55 00
			39 01 00 00 00 00 02 FF F0
			39 01 00 00 00 00 02 5A 02
			39 01 00 00 00 00 02 FF 10
			39 01 00 00 00 00 02 36 00
			39 01 00 00 00 00 02 35 00
			05 01 00 00 78 00 02 11 00
			05 01 00 00 14 00 02 29 00
		];
		qcom,mdss-dsi-off-command =
		[
			39 01 00 00 00 00 02 FF 10
			05 01 00 00 14 00 02 28 00
			05 01 00 00 78 00 02 10 00
		];
		qcom,mdss-dsi-on-command-state = "dsi_lp_mode";
		qcom,mdss-dsi-off-command-state = "dsi_hs_mode";
		qcom,mdss-dsi-h-sync-pulse = <1>;
		qcom,mdss-dsi-traffic-mode = "burst_mode";
		qcom,mdss-dsi-bllp-eof-power-mode;
		qcom,mdss-dsi-bllp-power-mode;
		qcom,mdss-dsi-lane-0-state;
		qcom,mdss-dsi-lane-1-state;
		qcom,mdss-dsi-lane-2-state;
		qcom,mdss-dsi-lane-3-state;
		qcom,mdss-dsi-t-clk-post = <0x0E>;
		qcom,mdss-dsi-t-clk-pre = <0x34>;
		qcom,mdss-dsi-bl-min-level = <1>;
		qcom,mdss-dsi-bl-max-level = <4095>;
		qcom,mdss-dsi-dma-trigger = "trigger_sw";
		qcom,mdss-dsi-mdp-trigger = "none";
		qcom,mdss-dsi-bl-pmic-control-type = "bl_ctrl_wled";
		qcom,mdss-dsi-reset-sequence = <1 10>, <0 10>, <1 10>;
		qcom,mdss-dsi-lp11-init;
	    qcom,esd-check-enabled;
		qcom,mdss-dsi-panel-status-command = [06 01 00 01 05 00 01 0A];
		qcom,mdss-dsi-panel-status-command-mode = "dsi_lp_mode";
		qcom,mdss-dsi-panel-status-check-mode = "reg_read";
		qcom,mdss-dsi-panel-status-read-length = <1>;
		qcom,mdss-dsi-panel-status-value = <0x9C>;
		qcom,mdss-dsi-panel-max-error-count = <3>;
		qcom,mdss-pan-physical-width-dimension = <69>;
		qcom,mdss-pan-physical-height-dimension = <122>;
	};
};
