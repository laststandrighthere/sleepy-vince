#include "vince-general.dtsi"
#include "vince-pinctrl.dtsi"
#include "common-pm.dtsi"
#include "vince-pm8953.dtsi"
#include "common-regulator.dtsi"
#include "vince-audio.dtsi"
#include "vince-display.dtsi"
#include "vince-pmi8950.dtsi"
#include "vince-qrd-sku3.dtsi"
#include "vince-qrd.dtsi"
#include "vince-camera.dtsi"