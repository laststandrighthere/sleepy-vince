&clock_cpu {
	qcom,speed2-bin-v0-cl =
		<          0 0>,
		<  652800000 1>,
		< 1036800000 2>,
		< 1401600000 3>,
		< 1689600000 4>,
		< 1804800000 5>,
		< 1958400000 6>,
		< 2016000000 7>,
		< 2150400000 8>,
		< 2208000000 9>;
	qcom,speed2-bin-v0-cci =
		<          0 0>,
		<  261120000 1>,
		<  414720000 2>,
		<  560640000 3>,
		<  675840000 4>,
		<  721920000 5>,
		<  783360000 6>,
		<  806400000 7>,
		<  860160000 8>,
		<  883200000 9>;
};
